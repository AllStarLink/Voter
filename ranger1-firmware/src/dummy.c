#include <stdio.h>
#include <p18f26j50.h>

#pragma config WDTEN = OFF,PLLDIV = 2, STVREN = ON, XINST = OFF, CPUDIV = OSC1, CP0 = OFF
#pragma config OSC = INTOSCPLLO, T1DIG = OFF, LPT1OSC = OFF, FCMEN = OFF, IESO = OFF

// Include all headers for any enabled TCPIP Stack functions
#include "TCPIP Stack/TCPIP.h"

#define SYSLED LATAbits.LATA1
#define RXLED LATAbits.LATA2
#define HOSTLED LATAbits.LATA3
#define FOOLED LATAbits.LATA5
#define PTT LATCbits.LATC6
#define TESTBIT FOOLED

WORD termbufidx;
WORD termbuftimer;

#define	TMR1VAL (65536 - 1333)

#if 0

rom unsigned char xaudio[] ={ 128,   173,   192,   173,   128,    82,    64,    82 } ;

rom unsigned short xaudiolen = 8;

#else

rom unsigned char xaudio[] = {
128,128,128,128,128,128,128,128,128,128,128,128,128,128,128,128,
128,128,128,128,129,129,129,129,129,128,128,128,128,128,128,128,
128,128,128,128,128,128,128,128,128,128,127,127,127,127,127,127,
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128,129,129,129,129,129,129,129,129
};
 
rom unsigned short xaudiolen = 14601;

#endif

unsigned short midx = 0;

/* Interrupt handler */
#pragma interrupt high_int
void high_int(void)
{
unsigned char x,y,encoded,sign;
unsigned short val;
signed short diff,s,step;


	/* TMR1 Interrupt */
	if (PIR1bits.TMR1IF && PIE1bits.TMR1IE)
	{
		unsigned char x,y;
		unsigned short val;

		T1CONbits.TMR1ON = 0;
		TMR1L = TMR1VAL & 0xff;
		TMR1H = TMR1VAL >> 8;
		T1CONbits.TMR1ON = 1;
TESTBIT ^= 1;
		val = xaudio[(midx++) >> 2];
		if ((midx >> 2) >= xaudiolen)
		{
			midx = 0;
		}
		// Set PWM accordingly
		val = val << 6;
		x = CCP1CON;
		x &= 0xcf;
		x |= (val & 0xff) >> 2;
		y = (val >> 8);
		CCP1CON = x;
		CCPR1L = y;
		PIR1bits.TMR1IF = 0;
	}

	/* ADC Interrupt */
	if (PIR1bits.ADIF && PIE1bits.ADIE)
	{
		PIR1bits.ADIF = 0;
	}
}

/* Glue to make Interrupt work */
#pragma code HIGH_INTERRUPT_VECTOR = 0x8
void HighISR(void)
{
	_asm
	goto high_int
	_endasm
}
#pragma code


// Declare AppConfig structure and some other supporting stack variables
APP_CONFIG AppConfig;

void main()
{
	OSCCON = 0;
	OSCTUNE = 0x80;
	DSCONH = 0;
	DSCONL = 0;
	OSCTUNEbits.PLLEN = 1;
	WDTCONbits.SWDTEN = 0;
	INTCON2bits.RBPU = 0;  // P/U controlled by TRISB bits
	// pump up processor speed to 48 MHz
	CCPR1L = 0;
	RPOR13 = 14;
	TRISA = 1; /* Bit 0 is analog input */
	TRISB = 0x1e; /* Bits 1-4 are outputs */
	TRISC = 0x11; /* Bits 0,4 are inputs */
	LATA = 0x2e;
	LATB = 0;
	LATC = 0;
	TESTBIT = 0;
	// Set up PWM initially
	CCP1CON = 0xc;
	PR2 = 0x3f;
	T2CON = 4;
	CCPR1L = 0x20;
	CCPR1H = 0;
	CCP1CON = 0xc;
	T1CON = 0x43;
	TMR1L = TMR1VAL & 0xff;
	TMR1H = TMR1VAL >> 8;
	IPR1bits.TMR1IP = 1;
	PIR1bits.TMR1IF = 0;
	PIE1bits.TMR1IE = 1;

	// Set Up A/D for audio input
	ADCON0 = 0;
	ADCON1 = 0xa2;
	ANCON0 = 0xfc;
	ANCON1 = 0x1f;
	ADCON0bits.ADON = 1;
	// Calibrate swine A/D
	ADCON1bits.ADCAL = 1;
	ADCON0bits.GO = 1;
	while(ADCON0bits.GO);
	ADCON1bits.ADCAL = 0;

	// Set Up Interrupts for A/D
	PIR1bits.ADIF = 0;
	IPR1bits.ADIP = 1;
	PIE1bits.ADIE = 1;

	// Enable global interrupts
	INTCONbits.GIE = 1;
	INTCONbits.GIEL = 1;

	HOSTLED = 0;

	PTT = 1;

	while(1) ;
}
